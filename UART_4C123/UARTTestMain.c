// UARTTestMain.c
// Runs on LM4F120/TM4C123
// Used to test the UART.c driver
// Daniel Valvano
// May 30, 2014

/* This example accompanies the book
   "Embedded Systems: Real Time Interfacing to Arm Cortex M Microcontrollers",
   ISBN: 978-1463590154, Jonathan Valvano, copyright (c) 2018

 Copyright 2018 by Jonathan W. Valvano, valvano@mail.utexas.edu
    You may use, edit, run or distribute this file
    as long as the above copyright notice remains
 THIS SOFTWARE IS PROVIDED "AS IS".  NO WARRANTIES, WHETHER EXPRESS, IMPLIED
 OR STATUTORY, INCLUDING, BUT NOT LIMITED TO, IMPLIED WARRANTIES OF
 MERCHANTABILITY AND FITNESS FOR A PARTICULAR PURPOSE APPLY TO THIS SOFTWARE.
 VALVANO SHALL NOT, IN ANY CIRCUMSTANCES, BE LIABLE FOR SPECIAL, INCIDENTAL,
 OR CONSEQUENTIAL DAMAGES, FOR ANY REASON WHATSOEVER.
 For more information about my classes, my research, and my books, see
 http://users.ece.utexas.edu/~valvano/
 */

// U0Rx (VCP receive) connected to PA0
// U0Tx (VCP transmit) connected to PA1
#include <stdint.h>
#include "PLL.h"
#include "UART.h"

//---------------------OutCRLF---------------------
// Output a CR,LF to UART to go to a new line
// Input: none
// Output: none
void OutCRLF(void){
  UART_OutChar(CR);
  UART_OutChar(LF);
}
const unsigned short BigGreen2[] = {
 0x0400, 0x0400, 0x0400, 0x0400, 0x0400, 0x0400, 0x0400, 0x0400, 0x0400, 0x0400, 0x0400, 0x0400, 0x0400, 0x0400, 0x0400, 0x0400,
 0x0400, 0x0400, 0x0400, 0x0400, 0x0400, 0x0400, 0x0400, 0x0400, 0x0400, 0x0400, 0x0400, 0x0400, 0x0400, 0x0400, 0x0400, 0x0400,
 0x0400, 0x0400, 0x0400, 0x0400, 0x0400, 0x0400, 0x0400, 0x0400, 0x0400, 0x0400, 0x0400, 0x0400, 0x0400, 0x0400, 0x0400, 0x0400,
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 0x0400, 0x0400, 0x0400, 0x0400, 0x0400, 0x0400, 0x0400, 0x0400, 0x0400, 0x0400, 0x0400, 0x0400, 0x0400, 0x0400, 0x0400, 0x0400
};
const unsigned short end[] = {0,0,0};
//------------ST7735_Color565------------
// Pass 8-bit (each) R,G,B and get back 16-bit packed color.
// Input: r red value
//        g green value
//        b blue value
// Output: 16-bit color
uint16_t ST7735_Color565(uint8_t r, uint8_t g, uint8_t b) {
  return ((b & 0xF8) << 8) | ((g & 0xFC) << 3) | (r >> 3);
}
//------------BSP_LCD_Color565------------
// Pass 8-bit (each) R,G,B and get back 16-bit packed color.
// Input: r red value
//        g green value
//        b blue value
// Output: 16-bit color
uint16_t BSP_LCD_Color565(uint8_t r, uint8_t g, uint8_t b) {
  return ((r & 0xF8) << 8) | ((g & 0xFC) << 3) | (b >> 3);
}

// convert 565 color to 233 (2red, 3green, 3 blue)
uint8_t Convert233(uint16_t color){
  uint32_t red,green,blue;
  uint8_t out;
  blue = (color&0xF800)>>10; // bits 15-11
  if(blue){
    while((blue&0x01)==0){
      blue = blue>>1;
    }
    while(blue>7){
      blue = blue>>1;
    }
  }
  green = (color&0x07E0)>>5; // bits 10-5
  if(green){
    while((green&0x01)==0){
      green = green>>1;
    }
    while(green>7){
      green = green>>1;
    }
  }
  red = color&0x001F;        // bits 4-0
  if(red){
    while((red&0x01)==0){
      red = red>>1;
    }
    while(red>3){
      red = red>>1;
    }
  }
  out = (red<<6)|     // red is bits 7,6
        (green<<3)|   // green is bits 5,4,3
        (blue);       // blue is bits 2,1,0
  return out;
}
//debug code
int main(void){const unsigned short *pt;
//  char ch;
//  char string[20];  // global to assist in debugging
  uint32_t n;

  PLL_Init(Bus50MHz);       // 50  MHz
  UART_Init();              // initialize UART
//  n=Convert233(ST7735_Color565(0,255,0));
//  n=Convert233(ST7735_Color565(0,0,255));
//  n=Convert233(ST7735_Color565(255,0,0));
//  n=Convert233(ST7735_Color565(255,255,0));
//  n=Convert233(ST7735_Color565(255,255,255));
  pt = BigGreen2;
  n=0;
  UART_OutString("\n\r  ");
  while(pt < end){
    UART_OutString("0x");
    UART_OutUHex(Convert233(*pt));
    pt++;
    UART_OutString(", ");
    n++;
    if(n==16){
      n=0;
      UART_OutString("\n\r  ");
    }
  }
  while(1){};
//  
//  OutCRLF();
//  for(ch='A'; ch<='Z'; ch=ch+1){// print the uppercase alphabet
//    UART_OutChar(ch);
//  }
//  OutCRLF();
//  UART_OutChar(' ');
//  for(ch='a'; ch<='z'; ch=ch+1){// print the lowercase alphabet
//    UART_OutChar(ch);
//  }
//  OutCRLF();
//  UART_OutChar('-');
//  UART_OutChar('-');
//  UART_OutChar('>');
//  while(1){
//    UART_OutString("InString: ");
//    UART_InString(string,19);
//    UART_OutString(" OutString="); UART_OutString(string); OutCRLF();

//    UART_OutString("InUDec: ");  n=UART_InUDec();
//    UART_OutString(" OutUDec="); UART_OutUDec(n); OutCRLF();

//    UART_OutString("InUHex: ");  n=UART_InUHex();
//    UART_OutString(" OutUHex="); UART_OutUHex(n); OutCRLF();

//  }
}
